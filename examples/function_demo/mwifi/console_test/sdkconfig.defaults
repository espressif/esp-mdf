## examples/function_demo/mwifi/console_test/sdkconfig.defaults
```kconfig
# Override some defaults in mesh application project.

#
# Serial flasher config
#
CONFIG_ESPTOOLPY_FLASHSIZE_4MB=y

#
# Partition Table
#
CONFIG_PARTITION_TABLE_CUSTOM=y

#
# FreeRTOS
#
CONFIG_FREERTOS_HZ=1000
CONFIG_FREERTOS_UNICORE=y
CONFIG_MAIN_TASK_STACK_SIZE=8192
CONFIG_FREERTOS_TIMER_TASK_STACK_DEPTH=3072
CONFIG_FREERTOS_USE_TRACE_FACILITY=y
CONFIG_FREERTOS_USE_STATS_FORMATTING_FUNCTIONS=y
CONFIG_FREERTOS_VTASKLIST_INCLUDE_COREID=y
CONFIG_FREERTOS_GENERATE_RUN_TIME_STATS=y

#
# Common ESP-related
#
CONFIG_ESP_TASK_WDT_PANIC=y
CONFIG_ESP_TASK_WDT_TIMEOUT_S=10

#
# mbedTLS
#
CONFIG_MBEDTLS_HARDWARE_MPI=y

#
# HTTP Server
#
CONFIG_HTTPD_MAX_REQ_HDR_LEN=4096

#
# MDF Mupgrade
#
CONFIG_MUPGRADE_FIRMWARE_CHECK=y
CONFIG_MUPGRADE_RESTART_COUNT=10
CONFIG_MUPGRADE_RESTART_TIMEOUT=500
CONFIG_MUPGRADE_VERSION_FALLBACK_FACTORY=n

#
# Wi-Fi
#
CONFIG_ESP32_WIFI_AMPDU_TX_ENABLED=y
CONFIG_ESP32_WIFI_AMPDU_RX_ENABLED=y

#
# MDF Mdebug
#
CONFIG_MDEBUG_STORE_HISTORY=y
CONFIG_MDEBUG_PARTITION_LABEL="storage"

#
# Wi-Fi optimized configuration
#
CONFIG_MWIFI_XON_QSIZE=64

CONFIG_FLASHMODE_QIO=y
CONFIG_ESPTOOLPY_FLASHFREQ_80M=y
CONFIG_LWIP_IRAM_OPTIMIZATION=y

CONFIG_ESP32_WIFI_STATIC_RX_BUFFER_NUM=16
CONFIG_ESP32_WIFI_DYNAMIC_RX_BUFFER_NUM=64
CONFIG_ESP32_WIFI_DYNAMIC_TX_BUFFER_NUM=64
CONFIG_ESP32_WIFI_TX_BA_WIN=32
CONFIG_ESP32_WIFI_RX_BA_WIN=32

CONFIG_MEMMAP_SMP=y
CONFIG_ESP32_DEFAULT_CPU_FREQ_240=y
CONFIG_ESP32_DEFAULT_CPU_FREQ_MHZ=240
```

## examples/function_demo/mwifi/main/Kconfig.projbuild
```kconfig
menu "Example Configuration"

config ROUTER_SSID
    string "Router SSID"
        default "ROUTER_SSID"
        help
            Router SSID.

config ROUTER_PASSWORD
    string "Router password"
        default "ROUTER_PASSWORD"
        help
            Router password.

config MESH_ID
    string "Mesh ID"
        default "123456"
        help
            Mesh network identification, Nodes with the same mesh ID can
            communicate with each other.


config MESH_PASSWORD
    string "Mesh Password"
    default "MESH_PASSWORD"
    help
        Mesh AP password. Password length must be 8 bits smaller than 64 bits,Set to null to not encrypt

config LED_GPIO_NUM
    int "LED pin GPIO number"
    range 0 33
    default 25
    help
        There are more enumerations like that
        up to GPIO39, excluding GPIO20, GPIO24 and GPIO28..31.
        They are not shown here to reduce redundant information.
        @note GPIO34..39 are input mode only.

config SERVER_IP
    string "Server IP address"
        default "192.168.0.1"
        help
            Server IP address.

config SERVER_PORT
    int "Server port"
        default "8070"
        help
            Server port.

endmenu
```

## examples/function_demo/mwifi/mqtt_example/main/Kconfig.projbuild
```kconfig
menu "Example Configuration"

config ROUTER_SSID
    string "Router SSID"
        default "my-ssid"
        help
            Router SSID.

config ROUTER_PASSWORD
    string "Router password"
        default "my-password"
        help
            Router password.

config MESH_ID
    string "Mesh ID"
        default "123456"
        help
            Mesh network identification, Nodes with the same mesh ID can
            communicate with each other.

config MESH_PASSWORD
    string "Mesh Password"
    default "MESH_PASSWORD"
    help
        Mesh AP password. Password length must be 8 bits smaller than 64 bits,Set to null to not encrypt

config MQTT_URL
    string "MQTT broker URL"
    default "mqtt://iot.eclipse.org"
    help
        URL of the broker to connect to

endmenu
```

## examples/function_demo/mwifi/mqtt_example/sdkconfig.defaults
```kconfig
# Override some defaults in mesh application project.

#
# Serial flasher config
#
CONFIG_ESPTOOLPY_FLASHSIZE_4MB=y

#
# Partition Table
#
CONFIG_PARTITION_TABLE_CUSTOM=y

#
# FreeRTOS
#
CONFIG_FREERTOS_HZ=1000
CONFIG_FREERTOS_UNICORE=y
CONFIG_FREERTOS_TIMER_TASK_STACK_DEPTH=3072
CONFIG_FREERTOS_USE_TRACE_FACILITY=y
CONFIG_FREERTOS_USE_STATS_FORMATTING_FUNCTIONS=y
CONFIG_FREERTOS_VTASKLIST_INCLUDE_COREID=y
CONFIG_FREERTOS_GENERATE_RUN_TIME_STATS=y

#
# Common ESP-related
#
CONFIG_ESP_TASK_WDT_PANIC=y
CONFIG_ESP_TASK_WDT_TIMEOUT_S=10

#
# mbedTLS
#
CONFIG_MBEDTLS_HARDWARE_MPI=y

#
# HTTP Server
#
CONFIG_HTTPD_MAX_REQ_HDR_LEN=4096

#
# MDF Mupgrade
#
CONFIG_MUPGRADE_FIRMWARE_CHECK=y
CONFIG_MUPGRADE_RESTART_COUNT=10
CONFIG_MUPGRADE_RESTART_TIMEOUT=500
CONFIG_MUPGRADE_VERSION_FALLBACK_FACTORY=n
	
#
# Wi-Fi
#
CONFIG_ESP32_WIFI_AMPDU_TX_ENABLED=n
CONFIG_ESP32_WIFI_AMPDU_RX_ENABLED=n
```

## examples/function_demo/mwifi/no_router/main/Kconfig.projbuild
```kconfig
menu "Example Configuration"

choice DEVICE_TYPE
    bool "Configure the device type"
    default DEVICE_TYPE_NODE
    help
        Configure the device type

config DEVICE_TYPE_IDLE
   bool "IDLE device"
config DEVICE_TYPE_ROOT
   bool "Root device"
config DEVICE_TYPE_NODE
   bool "Non-Root device"
config DEVICE_TYPE_LEAF
   bool "Leaf device"
endchoice

config DEVICE_TYPE
    int
    default 0 if DEVICE_TYPE_IDLE
    default 1 if DEVICE_TYPE_ROOT
    default 2 if DEVICE_TYPE_NODE
    default 3 if DEVICE_TYPE_LEAF

config MESH_ID
    string "Mesh ID"
        default "123456"
        help
            The maximum length is 6 bytes. Mesh network identification,
            Nodes with the same mesh ID can, communicate with each other.

config MESH_CHANNEL
    int "Mesh network channel"
    range 1 14
    default 13
    help
        Mesh network channel.

config UART_PORT_NUM
    int "UART PORT NUM"
    range 0 2
    default 1
    help
        choose uart port num.

config UART_BAUD_RATE
    int "UART BAUD RATE"
    range 0 921600
    default 115200
    help
        choose uart baud rate.

config UART_TX_IO
    int "UART TX IO"
    range 0 33
    default 5
    help
        choose uart tx IO.

config UART_RX_IO
    int "UART RX IO"
    range 0 33
    default 4
    help
        choose uart rx IO.

endmenu
```

## examples/function_demo/mwifi/root_on_ethernet/sdkconfig.defaults
```kconfig
# Override some defaults in mesh application project.

#
# Serial flasher config
#
CONFIG_ESPTOOLPY_FLASHSIZE_4MB=y

#
# Partition Table
#
CONFIG_PARTITION_TABLE_CUSTOM=y


#
# FreeRTOS
#
CONFIG_FREERTOS_UNICORE=y
CONFIG_FREERTOS_HZ=1000
CONFIG_TIMER_TASK_STACK_DEPTH=3072
CONFIG_FREERTOS_USE_TRACE_FACILITY=y
CONFIG_FREERTOS_USE_STATS_FORMATTING_FUNCTIONS=y

#
# ESP32-specific
#
CONFIG_TASK_WDT_PANIC=y
CONFIG_TASK_WDT_TIMEOUT_S=10
CONFIG_ESP32_ENABLE_COREDUMP=y
CONFIG_TIMER_TASK_STACK_SIZE=4096
CONFIG_ESP32_ENABLE_COREDUMP_TO_FLASH=y

#
# Wi-Fi
#
CONFIG_ESP32_WIFI_AMPDU_TX_ENABLED=
CONFIG_ESP32_WIFI_AMPDU_RX_ENABLED=

# Eth-helper
CONFIG_SERVER_PORT=8070
CONFIG_PHY_IP101=y
# CONFIG_PHY_TLK110 is not set
# CONFIG_PHY_LAN8720 is not set
CONFIG_PHY_ADDRESS=1
CONFIG_PHY_CLOCK_GPIO0_IN=y
# CONFIG_PHY_CLOCK_GPIO0_OUT is not set
# CONFIG_PHY_CLOCK_GPIO16_OUT is not set
# CONFIG_PHY_CLOCK_GPIO17_OUT is not set
CONFIG_PHY_CLOCK_MODE=0
CONFIG_PHY_USE_POWER_PIN=y
CONFIG_PHY_POWER_PIN=5
CONFIG_PHY_SMI_MDC_PIN=23
CONFIG_PHY_SMI_MDIO_PIN=18
#
```

## examples/function_demo/mwifi/router/main/Kconfig.projbuild
```kconfig
menu "Example Configuration"

config ROUTER_SSID
    string "Router SSID"
        default "ROUTER_SSID"
        help
            Router SSID.

config ROUTER_PASSWORD
    string "Router password"
        default "ROUTER_PASSWORD"
        help
            Router password.

config MESH_ID
    string "Mesh ID"
        default "123456"
        help
            Mesh network identification, Nodes with the same mesh ID can
            communicate with each other.

config MESH_PASSWORD
    string "Mesh Password"
    default "MESH_PASSWORD"
    help
        Mesh AP password. Password length must be 8 bits smaller than 64 bits,Set to null to not encrypt

config SERVER_IP
    string "Server IP address"
        default "192.168.0.1"
        help
            Server IP address.

config SERVER_PORT
    int "Server port"
        default "8070"
        help
            Server port.

endmenu
```

## examples/function_demo/mwifi/router/sdkconfig.defaults
```kconfig
# Override some defaults in mesh application project.

#
# Serial flasher config
#
CONFIG_ESPTOOLPY_FLASHSIZE_4MB=y

#
# Partition Table
#
CONFIG_PARTITION_TABLE_CUSTOM=y


#
# FreeRTOS
#
CONFIG_FREERTOS_UNICORE=y
CONFIG_FREERTOS_HZ=1000
CONFIG_TIMER_TASK_STACK_DEPTH=3072
CONFIG_FREERTOS_USE_TRACE_FACILITY=y
CONFIG_FREERTOS_USE_STATS_FORMATTING_FUNCTIONS=y

#
# ESP32-specific
#
CONFIG_TASK_WDT_PANIC=y
CONFIG_TASK_WDT_TIMEOUT_S=10
CONFIG_ESP32_ENABLE_COREDUMP=y
CONFIG_TIMER_TASK_STACK_SIZE=4096
CONFIG_ESP32_ENABLE_COREDUMP_TO_FLASH=y
```

## examples/get-started-cmake/main/Kconfig.projbuild
```kconfig
menu "Example Configuration"

choice DEVICE_TYPE
    bool "Configure the device type"
    default DEVICE_TYPE_NODE
    help
        Configure the device type

config DEVICE_TYPE_ROOT
   bool "Root device"
config DEVICE_TYPE_NODE
   bool "Non-Root device"
endchoice

config DEVICE_TYPE
    int
    default 1 if DEVICE_TYPE_ROOT
    default 2 if DEVICE_TYPE_NODE

config MESH_ID
    string "Mesh ID"
        default "123456"
        help
            The maximum length is 6 bytes. Mesh network identification,
            Nodes with the same mesh ID can, communicate with each other.

config MESH_CHANNEL
    int "Mesh network channel"
    range 1 14
    default 13
    help
        Mesh network channel.

endmenu
```

## examples/get-started/sdkconfig.defaults
```kconfig
# Override some defaults in mesh application project.

#
# Serial flasher config
#
CONFIG_ESPTOOLPY_FLASHSIZE_4MB=y

#
# Partition Table
#
CONFIG_PARTITION_TABLE_CUSTOM=y

#
# FreeRTOS
#
CONFIG_FREERTOS_HZ=1000
CONFIG_FREERTOS_UNICORE=y
CONFIG_FREERTOS_TIMER_TASK_STACK_DEPTH=3072
CONFIG_FREERTOS_USE_TRACE_FACILITY=y
CONFIG_FREERTOS_USE_STATS_FORMATTING_FUNCTIONS=y
CONFIG_FREERTOS_VTASKLIST_INCLUDE_COREID=y
CONFIG_FREERTOS_GENERATE_RUN_TIME_STATS=y

#
# Common ESP-related
#
CONFIG_ESP_TASK_WDT_PANIC=y
CONFIG_ESP_TASK_WDT_TIMEOUT_S=10

#
# High resolution timer (esp_timer)
#
CONFIG_ESP_TIMER_TASK_STACK_SIZE=4096

#
# Wi-Fi
#
CONFIG_ESP32_WIFI_AMPDU_TX_ENABLED=n
CONFIG_ESP32_WIFI_AMPDU_RX_ENABLED=n
```

## examples/light_bulb/main/Kconfig.projbuild
```kconfig
menu "Light bulb config"

choice MDF_LIGHT_TYPE
    bool "Configure the light type"
    default MDF_LIGHT_COREBOARD

config MDF_LIGHT_COREBOARD
   bool "Core Board"
config MDF_LIGHT_COLORED
   bool "Colored light"
endchoice

config MDF_LIGHT_TYPE
    int
    default 0 if MDF_LIGHT_COREBOARD
    default 1 if MDF_LIGHT_COLORED

endmenu
```

## examples/maliyun_linkkit/light/main/Kconfig.projbuild
```kconfig
menu "Example Configuration"

menu "device driver config"
config LIGHT_GPIO_RED
    int "Light red pin GPIO number"
    range 0 33
    default 25
    help
        There are more enumerations like that
        up to GPIO39, excluding GPIO20, GPIO24 and GPIO28..31.
        They are not shown here to reduce redundant information.
        @note GPIO34..39 are input mode only.

config LIGHT_GPIO_GREEN
    int "Light green pin GPIO number"
    range 0 33
    default 26
    help
        There are more enumerations like that
        up to GPIO39, excluding GPIO20, GPIO24 and GPIO28..31.
        They are not shown here to reduce redundant information.
        @note GPIO34..39 are input mode only.

config LIGHT_GPIO_BLUE
    int "Light blue pin GPIO number"
    range 0 33
    default 27
    help
        There are more enumerations like that
        up to GPIO39, excluding GPIO20, GPIO24 and GPIO28..31.
        They are not shown here to reduce redundant information.
        @note GPIO34..39 are input mode only.

config LIGHT_GPIO_COLD
    int "Light cold colors pin GPIO number"
    range 0 33
    default 23
    help
        There are more enumerations like that
        up to GPIO39, excluding GPIO20, GPIO24 and GPIO28..31.
        They are not shown here to reduce redundant information.
        @note GPIO34..39 are input mode only.

config LIGHT_GPIO_WARM
    int "Light warm color pin GPIO number"
    range 0 33
    default 19
    help
        There are more enumerations like that
        up to GPIO39, excluding GPIO20, GPIO24 and GPIO28..31.
        They are not shown here to reduce redundant information.
        @note GPIO34..39 are input mode only.

config LIGHT_FADE_PERIOD_MS
    int "The time from the current color to the next color"
    default 500
    help
        The time from the current color to the next color.

config LIGHT_BLINK_PERIOD_MS
    int "Period of blinking lights"
    default 2000
    help
        Period of blinking lights.
endmenu

config LIGHT_MEMORY_DEBUG
    bool "Enable memory debugging"
    default n
    help
        Enable memory debugging.

endmenu
```

## examples/meshkit_sense/main/Kconfig.projbuild
```kconfig
menu "ESP32-MeshKit-Sense config"

    config ENABLE_ULP_WAKEUP
        bool "Use ulp as a wakeup stub"
        default y
        help
            This option enables wake up from deep sleep using ULP.
            ULP program monitors the luminance sensor bh1750 and
            wakes up the chip when the luminance goes outside of
            low and upper threshold.

    config ULP_READ_INTERVAL
        int "Time interval of ulp read data from sensor (millisecond)"
        default 500
        depends on ENABLE_ULP_WAKEUP

    config LUMINANCE_THRESHOLD_LOW
        int "Low threshold of luminance to trigger"
        default 200
        range 0 500
        depends on ENABLE_ULP_WAKEUP

    config LUMINANCE_THRESHOLD_UPPER
        int "Upper threshold of luminance to trigger"
        default 600
        range 500 65536
        depends on ENABLE_ULP_WAKEUP

    config ENABLE_EXT1_WAKEUP
        bool "Use extern interrupt 1 as a wakeup stub"
        default y
        help
            The GPIO EXT1 is GPIO_NUM_34, actually it's WakeUp button in board,
            and when the chip wakes up from EXT1, it will switch to mesh mode.

    config ENABLE_TIMER_WAKEUP
        bool "Use timer as a wakeup stub"
        default n

    config TIMER_INTERVAL_DEEPSLEEP
        int "Timer interval of deepsleep (millisecond)"
        default 60000
        range 10000 65536
        depends on ENABLE_TIMER_WAKEUP

    config SENSE_DEEPSLEEP_DELAY_TIME
        int "Sleep delay time of touchpad in deepsleep mode(start from wakeup to deepsleep start, Calculated in milliseconds)"
        default 3000

    config USE_EPAPER_DISPLAY
        bool "Use epaper to display sensor status"
        default n

endmenu
```

## examples/touchpad/main/Kconfig.projbuild
```kconfig
menu "Mesh_touchpad config"

config TOUCHPAD_DEEPSLEEP_DELAY_TIME
    int "Sleep delay time of touchpad in deepsleep mode(start from wakeup to deepsleep start, Calculated in milliseconds)"
    default 3000

config COVER_THICK_LINEAR_SLIDER
    int "Linear slider plastic cover thickness (0 mm~1 mm)"
    range 0 1
    default 1
    help
        Supports plastic cover from 0 mm to 1 mm thickness

endmenu
```
