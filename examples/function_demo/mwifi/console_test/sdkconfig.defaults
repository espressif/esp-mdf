## examples/wireless_debug/sdkconfig.defaults
```kconfig
# Override some defaults in mesh application project.

#
# Serial flasher config
#
CONFIG_ESPTOOLPY_FLASHSIZE_4MB=y

#
# Partition Table
#
CONFIG_PARTITION_TABLE_CUSTOM=y

#
# FreeRTOS
#
CONFIG_FREERTOS_HZ=1000
CONFIG_FREERTOS_UNICORE=y
CONFIG_TIMER_TASK_STACK_DEPTH=4096
CONFIG_MAIN_TASK_STACK_SIZE=8192
CONFIG_FREERTOS_USE_TRACE_FACILITY=y
CONFIG_FREERTOS_USE_STATS_FORMATTING_FUNCTIONS=y
CONFIG_FREERTOS_VTASKLIST_INCLUDE_COREID=y
CONFIG_FREERTOS_GENERATE_RUN_TIME_STATS=y

#
# ESP32-specific
#
CONFIG_TASK_WDT_PANIC=y
CONFIG_TASK_WDT_TIMEOUT_S=30
CONFIG_ESP32_ENABLE_COREDUMP=y
CONFIG_TIMER_TASK_STACK_SIZE=4096
CONFIG_ESP32_ENABLE_COREDUMP_TO_FLASH=y

#
# Bluetooth
#
CONFIG_BT_ENABLED=y
CONFIG_GATTC_ENABLE=
CONFIG_BLE_SMP_ENABLE=
CONFIG_BT_ACL_CONNECTIONS=2
CONFIG_BLE_SCAN_DUPLICATE=
CONFIG_BT_BLE_DYNAMIC_ENV_MEMORY=y
CONFIG_BTDM_CONTROLLER_MODEM_SLEEP=
CONFIG_BT_STACK_NO_LOG=

#
# mbedTLS
#
CONFIG_MBEDTLS_HARDWARE_MPI=y

#
# HTTP Server
#
CONFIG_HTTPD_MAX_REQ_HDR_LEN=4096

#
# MDF Mupgrade
#
CONFIG_MUPGRADE_FIRMWARE_CHECK=y
CONFIG_MUPGRADE_RESTART_COUNT=10
CONFIG_MUPGRADE_RESTART_TIMEOUT=500
CONFIG_MUPGRADE_VERSION_FALLBACK_FACTORY=

# FatFS
CONFIG_FATFS_LFN_HEAP=y
CONFIG_FATFS_MAX_LFN=64

#
# MDF Mdebug
#
CONFIG_MDEBUG_STORE_HISTORY=y
CONFIG_MDEBUG_PARTITION_LABEL="storage"

#
# Mespnow queue size
#
CONFIG_MESPNOW_TRANS_PIPE_DEBUG_QUEUE_SIZE=60
```
