## components/mwifi/Kconfig
```kconfig
menu "MDF Mwifi"

    menu "Root config"

        config MWIFI_VOTE_PERCENTAGE
            int "Vote percentage threshold above which the node becoms a root"
            range 1 100
            default 90
            help
                Vote percentage threshold above which the node becoms a root

        config MWIFI_VOTE_MAX_COUNT
            int "Max vote counts in self-healing"
            range 1 100
            default 15
            help
                Max multiple voting each device can have for the self-healing of a mesh network

        config MWIFI_BACKOFF_RSSI
            int "RSSI threshold for connecting to the root"
            range -90 0
            default -78
            help
                RSSI threshold below which connections to the root node are not allowed

        config MWIFI_SCAN_MINI_COUNT
            int "Minimum scan times before being a root"
            default 10
            help
                Minimum scan times before being a root

        config MWIFI_ROOT_HEALING_MS
            int "Delay time before starting root healing"
            default 6000
            help
                Time lag between the moment a root node is disconnected from the network and the moment
                the devices start electing another root node

        config MWIFI_ROOT_CONFLICTS_ENABLE
            bool "Allow more than one root in one network"
            default n
            help
                Allow more than one root in one network

    endmenu

    menu "Capacity config"

        config MWIFI_CAPACITY_NUM
            int "Mesh network capacity"
            range 1 512
            default 512
            help
                Network capacity, defining max number of devices allowed in the mesh network.
        
        choice
            bool "Mesh Topology"
            default MESH_TOPO_TREE
            help 
                Mesh Network Topology
            config MESH_TOPO_TREE
                bool "MESH_TOPO_TREE"
            config MESH_TOPO_CHAIN
                bool "MESH_TOPO_CHAIN"
        endchoice
        
        config MWIFI_TOPOLOGY
            int
            default 0 if MESH_TOPO_TREE
            default 1 if MESH_TOPO_CHAIN
            help 
                Mesh Network Topology

        config MWIFI_MAX_LAYER
            int "Max number of allowed layers"
            range 1 25 if MESH_TOPO_TREE
            range 1 1000 if MESH_TOPO_CHAIN
            default 16
            help
                Max layer allowed in mesh network

        config MWIFI_MAX_CONNECTION
            int "Max number of mesh softAP connections"
            range 1 10
            default 6
            help
                Max number of mesh softAP connections

    endmenu

    menu "Stability config"

        config MWIFI_ASSOC_EXPIRE_MS
            int "Mesh softAP associate expired time"
            default 30000
            range 10000 60000
            help
                Period of time after which a mesh softAP breaks its association with inactive leaf nodes

        config MWIFI_BEACON_INTERVAL_MS
            int "Mesh softAP beacon interval"
            default 100
            help
                Mesh softAP beacon interval

        config MWIFI_PASSIVE_SCAN_MS
            int "Mesh station passive scan duration"
            default 300
            help
                Mesh station passive scan duration

        config MWIFI_MONITOR_DURATION_MS
            int "Parent weak RSSI monitor duration"
            default 60000
            range 1000 60000
            help
                Period (ms) for monitoring the parent's RSSI. If the signal stays weak throughout
                the period, the node will find another parent offering more stable connection

        config MWIFI_CNX_RSSI
            int "RSSI threshold above which the connection with a parent is considered strong"
            range -120 0
            default -120
            help
                RSSI threshold above which the connection with a parent is considered strong

        config MWIFI_SELECT_RSSI
            int "RSSI threshold for parent selection"
            range -120 0
            default -78
            help
                RSSI threshold for parent selection. Its value should be greater than switch_rssi

        config MWIFI_SWITCH_RSSI
            int "RSSI threshold below which a node selects a parent with better RSSI"
            range -120 0
            default -78
            help
                RSSI threshold below which a node selects a parent with better RSSI

        config MWIFI_ATTEMPT_COUNT
            int "The number of retries when the parent node disconnects"
            default 60
            help
                Max fails for a parent node to restore connection to the mesh network
                before it breaks the connection with its leaf nodes

        config MWIFI_MONITOR_IE_COUNT
            int "Acceptable times of parent ie change before update self ie"
            default 10
            help
                Allowed number of changes a parent node can introduce into its information element (IE),
                before the leaf nodes must update their own IEs accordingly

        config MWIFI_WAIVE_ROOT
            bool "Reselect the root when the RSSI is weak"
            default y
            help
                Cause the root device to give up (waive) its mesh root status,
                A device is elected root primarily based on RSSI from the external router

        config MWIFI_WAIVE_ROOT_RSSI
            int "Reselect the RSSI threshold of the root node"
            range -120 0
            default -70
            depends on MWIFI_WAIVE_ROOT
            help
                When the RSSI between the root and the router is lower than this value,
                the reselection root is triggered.

        config MWIFI_RSSI_THRESHOUD_HIGH
            int "high level of the rssi_threshoud for three level"
            range -85 -55
            default -78

        config MWIFI_RSSI_THRESHOUD_MEDIUM
            int "medium level of the rssi_threshoud for three level"
            range -85 -55
            default -82

        config MWIFI_RSSI_THRESHOUD_LOW
            int "low level of the rssi_threshoud for three level"
            range -85 -55
            default -85

    endmenu

    menu "Transmission config"

        config MWIFI_XON_QSIZE
            int "The number of mesh buffer queues"
            default 32
            help
                The number of mesh buffer queues.

        config MWIFI_RETRANSMIT_ENABLE
            bool "If retransmission on mesh stack"
            default y
            help
                Enable a source node to retransmit data to the node from which it failed to receive ACK

        config MWIFI_DATA_DROP_ENABLE
            bool "Discard packets when the root changes"
            default y
            help
                If a root is changed, enable the new root to drop the previous packet

        config MWIFI_MESH_IE_ENABLE
            bool "Enable mesh IE encryption"
            default y
            help
                If you use wifi receiver to get 802.11 packet analysis,
                you need to disable mesh IE encryption. mesh IE encryption is not compatible with unencrypted versions.

    endmenu

    menu "Power save config"
        config MWIFI_ENABLE_PS
            bool "Enable mesh PS (power save) function"
            default n
            help
                Enable/Disable Power Save function.

        choice
            bool "Mesh PS device duty cycle type"
            depends on MWIFI_ENABLE_PS
            default MWIFI_PS_DEV_DUTY_TYPE_REQUEST
            help
                Mesh PS device duty cycle type.

            config MWIFI_PS_DEV_DUTY_TYPE_REQUEST
                bool "MWIFI_PS_DEV_DUTY_TYPE_REQUEST"
            config MWIFI_PS_DEV_DUTY_TYPE_DEMAND
                bool "MWIFI_PS_DEV_DUTY_TYPE_DEMAND"
        endchoice

        config MWIFI_PS_DEV_DUTY_TYPE
            int
            depends on MWIFI_ENABLE_PS
            default 1 if MWIFI_PS_DEV_DUTY_TYPE_REQUEST
            default 4 if MWIFI_PS_DEV_DUTY_TYPE_DEMAND
            help
                Mesh PS device duty cycle type.

        config MWIFI_PS_DEV_DUTY
            int "Mesh PS device duty cycle"
            depends on MWIFI_ENABLE_PS
            range 1 100
            default 10
            help
                Mesh PS device duty cycle.

        config MWIFI_PS_NWK_DUTY
            int "Mesh PS network duty cycle"
            depends on MWIFI_ENABLE_PS
            range 1 100
            default 10
            help
                Mesh PS network duty cycle.

        config MWIFI_PS_NWK_DUTY_DURATION
            int "Mesh PS network duty cycle duration (unit: minutes)"
            depends on MWIFI_ENABLE_PS
            range -1 100
            default -1
            help
                Mesh PS network duty cycle duration.

        choice
            bool "Mesh PS network duty cycle rule"
            depends on MWIFI_ENABLE_PS
            default MWIFI_PS_NETWORK_DUTY_APPLIED_ENTIRE
            help
                Mesh PS network duty cycle rule.

            config MWIFI_PS_NETWORK_DUTY_APPLIED_ENTIRE
                bool "MWIFI_PS_NETWORK_DUTY_APPLIED_ENTIRE"
            config MWIFI_PS_NETWORK_DUTY_APPLIED_UPLINK
                bool "MWIFI_PS_NETWORK_DUTY_APPLIED_UPLINK"
        endchoice

        config MWIFI_PS_NWK_DUTY_RULE
            int
            depends on MWIFI_ENABLE_PS
            default 0 if MWIFI_PS_NETWORK_DUTY_APPLIED_ENTIRE
            default 1 if MWIFI_PS_NETWORK_DUTY_APPLIED_UPLINK
            help
                Mesh PS network duty cycle rule.
    endmenu
endmenu
```

## components/third_party/aliyun_sdk/Kconfig
```kconfig
menuconfig ALIYUN_IOT_NEW_SDK
    bool "new aliyun sdk IoT Platform"
    help
       Select this option to enable support for the aliyun IoT platform,
       via the esp-mdf/esp-idf component for the aliyun adk.

    choice ALIYUN_PLATFORM_SDK_CHOOSE
    depends on ALIYUN_IOT_NEW_SDK
        prompt "Choose MDF/IDF platform"
        default ALIYUN_PLATFORM_MDF
        help
            Choose the MDF/IDF platform which you want to use. MDF for MESH application, IDF for direct Wi-Fi direct connection application.

    config ALIYUN_PLATFORM_MDF
        bool "MDF"
    config ALIYUN_PLATFORM_IDF
        bool "IDF"
    endchoice

    choice ALIYUN_SUPPORT_TLS_CHOOSE
    depends on ALIYUN_IOT_NEW_SDK
        prompt "Choose TLS/TCP connection"
        default ALIYUN_NETWORK_SUPPORT_TLS
        help
            Choose the TLS/TCP connection which you want to use.

    config ALIYUN_NETWORK_SUPPORT_TLS
        bool "TLS"
    config ALIYUN_NETWORK_SUPPORT_TCP
        bool "TCP"
    endchoice

    choice ALIYUN_MQTT_MODE_CHOOSE
    depends on ALIYUN_IOT_NEW_SDK
        prompt "Choose PRE_AUTH/DIRECT mode"
        default ALIYUN_MQTT_MODE_DIRECT
        help
            Choose the PRE_AUTH/DIRECT mode which you want to use.

    config ALIYUN_MQTT_MODE_DIRECT
        bool "mqtt mode direct"
    config ALIYUN_MQTT_MODE_PRE_AUTH
        bool "mqtt mode pre auth"

    endchoice
    
    config ALIYUN_TASK_DEFAULT_PRIOTY
    depends on ALIYUN_IOT_NEW_SDK
        int "aliyun sdk task priority"
        range 0 10
        default 8
        help
            aliyun sdk task priority, include aliyun_gateway_write, aliyun_gateway_read and aliyun_subdevice_task.

    config ALIYUN_DISCONNECT_DELAY_NOTIFY
    depends on ALIYUN_IOT_NEW_SDK
        int "disconnect_delay_notify"
        range 0 120
        default 60
        help 
            when mqtt is disconnected, it will start software timer use this value(seconds), if mqtt is reconnected 
            before software timer triger, it won't send toDS=false to subdevice.

menu "aliyun sdk mqtt config"
depends on ALIYUN_IOT_NEW_SDK

    config ALIYUN_MQTT_TASK_PRIOTY
        int "aliyun mqtt task priority"
        range 0 10
        default 9
        help
            aliyun mqtt task priority, It should not less than aliyun sdk task priority.

    config ALIYUN_MQTT_TASK_SIZE
        int "aliyun mqtt task size"
        range 0 10240
        default 8192
        help
            aliyun mqtt task size.

    config ALIYUN_TOPIC_SIZE
        int "aliyun mqtt topic size"
        range 0 256
        default 128
        help
            aliyun mqtt topic size.

    config ALIYUN_PAYLOAD_SIZE 
        int "aliyun mqtt payload size"
        range 0 10240
        default 1024
        help
            aliyun mqtt payload size.

    config ALIYUN_MQTT_WS_WSS_PORT
        int "aliyun mqtt ws/wss port"
        range 0 65535
        default 433
        help
            aliyun mqtt ws/wss port.

    config ALIYUN_MQTT_TCP_TLS_PORT
        int "aliyun mqtt tcp/tls port"
        range 0 65535
        default 1883
        help
            aliyun mqtt tcp/tls port.
    endmenu

menu "aliyun sdk message config"
depends on ALIYUN_IOT_NEW_SDK
    config BLUFI_BROADCAST_OUI
        string "MDF aliyun network config type"
        default "MAY"
        help
            MDF aliyun network config type

    config ALIYUN_READ_TIMROUT_MS
        int "aliyun read_timeout ms"
        range 0 1000
        default 50
        help
            aliyun read_timeout ms.

    config ALIYUN_ANSWER_DEFAULT_RESENDS_NUM
        int "aliyun answer default resends num"
        range 0 10
        default 3
        help
            aliyun answer default resends num.

    config ALIYUN_ANSWER_DEFAULT_TIMEOUT_MS
        int "aliyun answer default timeout ms"
        range 100 100000
        default 10000
        help
            aliyun answer default timeout ms.
endmenu
```

## components/third_party/miniz/Kconfig
```kconfig
menu "MINIZ"

    config MINIZ_SPLIT_TINFL_DECOMPRESSOR_TAG
        bool "Allocate memory multiple times in decompress"
        default y
        help
           Make a static array in the struct tinfl_decompressor_tag a pointer and allocate 
           memory for it when it is used 
        
    config MINIZ_SPLIT_TDEFL_COMPRESSOR
        bool "Allocate memory multiple times in compress"
        default y
        help
            Make a static array in the tdefl_compressor a pointer and allocate memory 
            for it when it is used
        
    config MINIZ_MINIMIZE_STACK_CONSUME
        bool "Low stack usage"
        default y
        help
            Change the large array in the stack to a pointer and allocate memory for it to reduce stack consumption, 
            The affected functions are tdefl_radix_sort_syms(), tdefl_optimize_huffman_table(),
            tdefl_start_dynamic_block().
        
endmenu
```

## examples/aliyun_linkkit/get-started/main/Kconfig.projbuild
```kconfig
menu "Example Configuration"

config WIFI_SSID
    string "Wi-Fi ssid"
    default "myssid"

config WIFI_PSWD
    string "Wi-Fi password"
    default "mypassword"

config DEVICE_VERSION
    string "Device version"
    default "1.0.0"

menu "aliyun config"
    config ALIYUN_META_PRODUCT_KEY
        string "Aliyun product key"
        default "xxxx"
        help 
            Aliyun product key.

    config ALIYUN_META_PRODUCT_SECRET
        string "Aliyun product secret"
        default "xxxx"
        help
            Aliyun product secret.

    config ALIYUN_META_DEVICE_NAME
        string "Aliyun device name"
        default "xxxx"
        help 
            Aliyun device name

    config ALIYUN_META_DEVICE_SECRET
        string "Aliyun device secret"
        default "xxxx"
        help
            Aliyun device secret
endmenu

endmenu
```

## examples/aliyun_linkkit/get-started/sdkconfig.defaults
```kconfig
#
# new aliyun sdk IoT Platform
CONFIG_ALIYUN_IOT_NEW_SDK=y
CONFIG_ALIYUN_PLATFORM_IDF=y

# partition
CONFIG_PARTITION_TABLE_CUSTOM=y

# flash
CONFIG_ESPTOOLPY_FLASHSIZE_4MB=y
```
