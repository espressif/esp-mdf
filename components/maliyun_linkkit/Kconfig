## examples/factory/main/Kconfig.projbuild
```kconfig
menu "Factory Config"

config MDF_BOOTLOADER_CUSTOMIZATION
    bool "Enable bootloader customization"
    default y
    help
       If you enable this configuration, you can switch the device to the factory mode
       by switching power of device 3 to 10 times (each time within 500ms) consecutively.

config MDF_BOOTLOADER_COUNT_MIN
    int "Min Count of Switching Power"
    default 3
    depends on MDF_BOOTLOADER_CUSTOMIZATION
    help
        Configure min count of switching power to enter customized bootloader

config MDF_BOOTLOADER_COUNT_MAX
    int "Max Count of Switching Power"
    default 10
    depends on MDF_BOOTLOADER_CUSTOMIZATION
    help
        Configure max count of switching power to enter customized bootloader

endmenu
```

## examples/function_demo/mcommon/sdkconfig.defaults
```kconfig
# Override some defaults in mesh application project.

#
# Serial flasher config
#
CONFIG_ESPTOOLPY_FLASHSIZE_4MB=y

#
# Partition Table
#
CONFIG_PARTITION_TABLE_CUSTOM=y

#
# FreeRTOS
#
CONFIG_FREERTOS_HZ=1000
CONFIG_FREERTOS_UNICORE=y
CONFIG_TIMER_TASK_STACK_DEPTH=3072
CONFIG_FREERTOS_USE_TRACE_FACILITY=y
CONFIG_FREERTOS_USE_STATS_FORMATTING_FUNCTIONS=y

#
# ESP32-specific
#
CONFIG_TASK_WDT_PANIC=y
CONFIG_TASK_WDT_TIMEOUT_S=10
CONFIG_ESP32_ENABLE_COREDUMP=y
CONFIG_TIMER_TASK_STACK_SIZE=4096
CONFIG_ESP32_ENABLE_COREDUMP_TO_FLASH=y

#
# Heap memory debugging
#
CONFIG_HEAP_POISONING_COMPREHENSIVE=y
CONFIG_HEAP_TRACING=y
CONFIG_HEAP_TASK_TRACKING=y

#
# MDF Mcommon
#
CONFIG_MDF_MEM_DEBUG=y
```

## examples/function_demo/mconfig/sdkconfig.defaults
```kconfig
# Override some defaults in mesh application project.

#
# Serial flasher config
#
CONFIG_ESPTOOLPY_FLASHSIZE_4MB=y

#
# Partition Table
#
CONFIG_PARTITION_TABLE_CUSTOM=y

#
# FreeRTOS
#
CONFIG_FREERTOS_HZ=1000
CONFIG_FREERTOS_UNICORE=y
CONFIG_FREERTOS_TIMER_TASK_STACK_DEPTH=3072
CONFIG_FREERTOS_USE_TRACE_FACILITY=y
CONFIG_FREERTOS_USE_STATS_FORMATTING_FUNCTIONS=y
CONFIG_FREERTOS_VTASKLIST_INCLUDE_COREID=y
CONFIG_FREERTOS_GENERATE_RUN_TIME_STATS=y

#
# Common ESP-related
#
CONFIG_ESP_TASK_WDT_PANIC=y
CONFIG_ESP_TASK_WDT_TIMEOUT_S=10

#
# BT config
#
CONFIG_BT_ENABLED=y
CONFIG_BTDM_CTRL_MODE_BLE_ONLY=y
CONFIG_BTDM_CTRL_MODE_BR_EDR_ONLY=n
CONFIG_BTDM_CTRL_MODE_BTDM=n
CONFIG_BTDM_CTRL_PINNED_TO_CORE_0=y
CONFIG_BTDM_CTRL_PINNED_TO_CORE_1=n
CONFIG_BTDM_CTRL_PINNED_TO_CORE=0
CONFIG_BTDM_CTRL_HCI_MODE_VHCI=y
CONFIG_BTDM_CTRL_HCI_MODE_UART_H4=n
CONFIG_BT_BLUEDROID_ENABLED=y
CONFIG_BT_BLUEDROID_PINNED_TO_CORE_0=y
CONFIG_BT_BLUEDROID_PINNED_TO_CORE_1=n
CONFIG_BT_BLUEDROID_PINNED_TO_CORE=0
CONFIG_BT_BTC_TASK_STACK_SIZE=3072
CONFIG_BT_BLUEDROID_MEM_DEBUG=n
CONFIG_BT_CLASSIC_ENABLED=n
CONFIG_BT_GATTS_ENABLE=y
CONFIG_BT_GATTC_ENABLE=n
CONFIG_BT_BLE_SMP_ENABLE=n
CONFIG_BL_ENABLE_SRVCHG_REG=y
CONFIG_BT_STACK_NO_LOG=n
CONFIG_BT_ACL_CONNECTIONS=4
CONFIG_BT_ALLOCATION_FROM_SPIRAM_FIRST=n
CONFIG_BT_BLE_DYNAMIC_ENV_MEMORY=n
CONFIG_BT_SMP_ENABLE=n
CONFIG_BT_BLE_BLUFI_ENABLE=y
CONFIG_MBEDTLS_HARDWARE_MPI=n
CONFIG_BT_BLE_42_FEATURES_SUPPORTED=y

#
# mbedTLS
#
CONFIG_MBEDTLS_HARDWARE_MPI=y

#
# Wi-Fi
#
CONFIG_ESP32_WIFI_AMPDU_TX_ENABLED=y
CONFIG_ESP32_WIFI_AMPDU_RX_ENABLED=y
```

## examples/function_demo/mdebug/main/Kconfig.projbuild
```kconfig
menu "Example Configuration"

config ROUTER_SSID
    string "Router SSID"
        default "ROUTER_SSID"
        help
            Router SSID.

config ROUTER_PASSWORD
    string "Router password"
        default "ROUTER_PASSWORD"
        help
            Router password.

config MESH_ID
    string "Mesh ID"
        default "123456"
        help
            Mesh network identification, Nodes with the same mesh ID can
            communicate with each other.

config MESH_PASSWORD
    string "Mesh Password"
    default "MESH_PASSWORD"
    help
        Mesh AP password. Password length must be 8 bits smaller than 64 bits,Set to null to not encrypt

config FLASH_LOG_POST_URL
    string "Flash log url endpoint"
    default "http://192.168.0.3:8070/flash_log"
    help
        Flash log url endpoint.

endmenu
```

## examples/function_demo/mupgrade/main/Kconfig.projbuild
```kconfig
menu "Example Configuration"

config DEVICE_VERSION
    string "Device version"
    default "0.0.1"
    help
        Config device version

config ROUTER_SSID
    string "Router SSID"
        default "ROUTER_SSID"
        help
            Router SSID.

config ROUTER_PASSWORD
    string "Router password"
        default "ROUTER_PASSWORD"
        help
            Router password.

config MESH_ID
    string "Mesh ID"
        default "123456"
        help
            Mesh network identification, Nodes with the same mesh ID can
            communicate with each other.

config FIRMWARE_UPGRADE_URL
    string "Firmware upgrade url endpoint"
    default "http://192.168.0.3:8070/hello-world.bin"
    help
        URL of server which hosts the firmware image.

endmenu
```
