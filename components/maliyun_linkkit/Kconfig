## examples/aliyun_linkkit/mesh-with-aliyun/main/Kconfig.projbuild
```kconfig
menu "Example Configuration"

config DEVICE_VERSION
    string "Device version"
    default "1.0.0"

config MESH_ID
    string "Mesh ID"
    default "123456"
    help
        The maximum length is 6 bytes. Mesh network identification,
        Nodes with the same mesh ID can, communicate with each other.

config MESH_CHANNEL
    int "Mesh network channel"
    range 1 14
    default 13
    help
        Mesh network channel.

config ROUTER_SSID
    string "Router ssid"
    default "myssid"

config ROUTER_PASSWORD
    string "Router password"
    default "mypassword"

menu "aliyun config"
    config ALIYUN_META_PRODUCT_KEY
        string "Aliyun product key"
        default "xxxx"
        help 
            Aliyun product key.

    config ALIYUN_META_PRODUCT_SECRET
        string "Aliyun product secret"
        default "xxxx"
        help
            Aliyun product secret.

    config ALIYUN_META_DEVICE_NAME
        string "Aliyun device name"
        default "xxxx"
        help 
            Aliyun device name

    config ALIYUN_META_DEVICE_SECRET
        string "Aliyun device secret"
        default "xxxx"
        help
            Aliyun device secret
endmenu

endmenu
```

## examples/aliyun_linkkit/mesh-with-aliyun/sdkconfig.defaults
```kconfig
#
# new aliyun sdk IoT Platform
CONFIG_ALIYUN_IOT_NEW_SDK=y
CONFIG_ALIYUN_PLATFORM_MDF=y

#
# MUPGRADE
CONFIG_MUPGRADE_RETRY_COUNT=15

#
# Partition Table
CONFIG_PARTITION_TABLE_CUSTOM=y
CONFIG_PARTITION_TABLE_CUSTOM_FILENAME="partitions.csv"

# FreeRTOS
CONFIG_TIMER_TASK_STACK_DEPTH=2560
```

## examples/development_kit/button/main/Kconfig.projbuild
```kconfig
menu "Example Configuration"

config BUTTON_VERSION
    string "Button version"
    default "1.0.0"
    help
        Version of the five-color light

config BUTTON_MEMORY_DEBUG
    bool "Enable memory debugging"
    default n
    help
        Enable memory debugging.

endmenu
```

## examples/development_kit/light/main/Kconfig.projbuild
```kconfig
menu "Example Configuration"

    menu "light driver config"
    config LIGHT_GPIO_RED
        int "Light red pin GPIO number"
        range 0 33
        default 4
        help
            There are more enumerations like that
            up to GPIO39, excluding GPIO20, GPIO24 and GPIO28..31.
            They are not shown here to reduce redundant information.
            @note GPIO34..39 are input mode only.
    
    config LIGHT_GPIO_GREEN
        int "Light green pin GPIO number"
        range 0 33
        default 16
        help
            There are more enumerations like that
            up to GPIO39, excluding GPIO20, GPIO24 and GPIO28..31.
            They are not shown here to reduce redundant information.
            @note GPIO34..39 are input mode only.
    
    config LIGHT_GPIO_BLUE
        int "Light blue pin GPIO number"
        range 0 33
        default 5
        help
            There are more enumerations like that
            up to GPIO39, excluding GPIO20, GPIO24 and GPIO28..31.
            They are not shown here to reduce redundant information.
            @note GPIO34..39 are input mode only.
    
    config LIGHT_GPIO_COLD
        int "Light cold colors pin GPIO number"
        range 0 33
        default 19
        help
            There are more enumerations like that
            up to GPIO39, excluding GPIO20, GPIO24 and GPIO28..31.
            They are not shown here to reduce redundant information.
            @note GPIO34..39 are input mode only.
    
    config LIGHT_GPIO_WARM
        int "Light warm color pin GPIO number"
        range 0 33
        default 23
        help
            There are more enumerations like that
            up to GPIO39, excluding GPIO20, GPIO24 and GPIO28..31.
            They are not shown here to reduce redundant information.
            @note GPIO34..39 are input mode only.
    
    config LIGHT_FADE_PERIOD_MS
        int "The time from the current color to the next color"
        default 500
        help
            The time from the current color to the next color.
    
    config LIGHT_BLINK_PERIOD_MS
        int "Period of blinking lights"
        default 2000
        help
            Period of blinking lights.
    endmenu

    choice LIGHT_EXAMPLE_MODE
        bool "Select light example mode"
        default LIGHT_EXAMPLE_MESH
        help 
            Specify which light example to build,support mesh-light or mesh-light with aliyun
        config LIGHT_EXAMPLE_MESH
        bool "mesh light"
        config LIGHT_EXAMPLE_ALIYUN
        bool "mesh light with aliyun"
        
    endchoice

    config LIGHT_EXAMPLE_MODE
        int
        default 0 if LIGHT_EXAMPLE_MESH
        default 1 if LIGHT_EXAMPLE_ALIYUN

    menu "mesh light config"
        depends on LIGHT_EXAMPLE_MESH
        config LIGHT_VERSION
            string "Light version"
            default "1.2.2"
            help
                Version of the five-color light
        
        config LIGHT_MEMORY_DEBUG
            bool "Enable memory debugging"
            default n
            help
                Enable memory debugging.
        
        config LIGHT_BLE_GATEWAY
            bool "Enable the BLE gateway on the non-root node"
            default n
            help
                Enabling the BLE gateway on a non-root node,
                enabling the BLE gateway will consume a lot of memory.
    
        config LIGHT_NETWORKING_TIME_OPTIMIZE_ENABLE
            bool "Optimize networking time"
            default n
            help
                1. Set the Bluetooth configuration network device to a fixed root node, eliminating the time of competing for the root node
                2. Once the networking is complete, select again whether there is a better root node.
                3. When power is turned on again, the device that was the root node last time is selected as the root node by default.
        
        config LIGHT_RESTART_COUNT_RESET
            int "Reset the number of times the device has been powered off continuously to enter the configured network mode"
            range 3 10
            default 5
            help
                Reset the number of times the device has been powered off continuously to enter the configured network mode.
        
        config LIGHT_RESTART_COUNT_FALLBACK
            int "Number of times the device restarted abnormally, entered, and exited from the previous version"
            range 15 32
            default 15
            help
                Number of times the device restarted abnormally, entered, and exited from the previous version.
    
    endmenu

    menu "aliyun config"
        depends on LIGHT_EXAMPLE_ALIYUN
        config LIGHT_VERSION
            string "Light version"
            default "1.1.1"
            help
                Version of the five-color light
    
        config ALIYUN_META_PRODUCT_KEY
            string "Aliyun product key"
            default "xxxx"
            help
                Aliyun product key.
    
        config ALIYUN_META_PRODUCT_SECRET
            string "Aliyun product secret"
            default "xxxx"
            help
                Aliyun product secret.
    
        config ALIYUN_META_DEVICE_NAME
            string "Aliyun device name"
            default "xxxx"
            help
                Aliyun device name.
    
        config ALIYUN_META_DEVICE_SECRET
            string "aliyun device secret"
            default "xxxx"
            help
                Aliyun device secret.
    endmenu

endmenu
```

## examples/development_kit/light/sdkconfig.defaults
```kconfig
# Override some defaults in mesh application project.

#
# Serial flasher config
#
CONFIG_ESPTOOLPY_FLASHSIZE_4MB=y

#
# Partition Table
#
CONFIG_PARTITION_TABLE_CUSTOM=y

#
# Wi-Fi
#
CONFIG_ESP32_WIFI_AMPDU_TX_ENABLED=
CONFIG_ESP32_WIFI_AMPDU_RX_ENABLED=
CONFIG_ESP_WIFI_FTM_INITIATOR_SUPPORT=n
CONFIG_ESP_WIFI_FTM_RESPONDER_SUPPORT=n

#
# FreeRTOS
#
CONFIG_FREERTOS_HZ=1000
CONFIG_FREERTOS_UNICORE=y
CONFIG_FREERTOS_TIMER_TASK_STACK_DEPTH=3072
CONFIG_FREERTOS_USE_TRACE_FACILITY=y
CONFIG_FREERTOS_USE_STATS_FORMATTING_FUNCTIONS=y
CONFIG_FREERTOS_VTASKLIST_INCLUDE_COREID=y
CONFIG_FREERTOS_GENERATE_RUN_TIME_STATS=y

#
# ESP32-specific
#
CONFIG_ESP_TASK_WDT_PANIC=y
CONFIG_ESP_TASK_WDT_TIMEOUT_S=30
CONFIG_ESP32_ENABLE_COREDUMP=y
CONFIG_ESP_TIMER_TASK_STACK_SIZE=4096

#
# Bluetooth
#
CONFIG_BT_ENABLED=y
CONFIG_GATTC_ENABLE=
CONFIG_BLE_SMP_ENABLE=
CONFIG_BT_ACL_CONNECTIONS=2
CONFIG_BLE_SCAN_DUPLICATE=
CONFIG_BT_BLE_DYNAMIC_ENV_MEMORY=y
CONFIG_BTDM_CONTROLLER_MODEM_SLEEP=
CONFIG_BT_STACK_NO_LOG=
CONFIG_BT_BLE_SMP_ENABLE=y
CONFIG_BT_BLE_BLUFI_ENABLE=y
CONFIG_BT_BLE_42_FEATURES_SUPPORTED=y

CONFIG_BTDM_CTRL_MODE_BLE_ONLY=y

#
# Bootloader config
#
CONFIG_BOOTLOADER_OFFSET_IN_FLASH=0x1000

#
# mbedTLS
#
CONFIG_MBEDTLS_HARDWARE_MPI=y
CONFIG_MBEDTLS_DYNAMIC_BUFFER=y
CONFIG_MBEDTLS_DYNAMIC_FREE_PEER_CERT=y
CONFIG_MBEDTLS_DYNAMIC_FREE_CONFIG_DATA=y
CONFIG_MBEDTLS_SSL_PROTO_TLS1=n
CONFIG_MBEDTLS_SSL_PROTO_TLS1_1=n
CONFIG_MBEDTLS_TLS_CLIENT_ONLY=y

#
# HTTP Server
#
CONFIG_HTTPD_MAX_REQ_HDR_LEN=4096

#
# MDF Mupgrade
#
CONFIG_MUPGRADE_FIRMWARE_CHECK=y
CONFIG_MUPGRADE_RESTART_COUNT=10
CONFIG_MUPGRADE_RESTART_TIMEOUT=500
CONFIG_MUPGRADE_VERSION_FALLBACK_FACTORY=

#
# mesh light config
#
CONFIG_LIGHT_VERSION="1.4.4-master"

# Compiler options
CONFIG_COMPILER_OPTIMIZATION_SIZE=y

# Newlib
# CONFIG_NEWLIB_NANO_FORMAT=y 

# Virtual file system
CONFIG_VFS_SUPPORT_DIR=n
CONFIG_VFS_SUPPORT_SELECT=n
CONFIG_VFS_SUPPORT_TERMIOS=n

# ESP NETIF Adapter
CONFIG_ESP_NETIF_TCPIP_ADAPTER_COMPATIBLE_LAYER=n

# Common ESP-related
CONFIG_ESP_ERR_TO_NAME_LOOKUP=n

# ESP-MQTT Configurations
CONFIG_MQTT_TRANSPORT_WEBSOCKET=n

# LWIP
# CONFIG_LWIP_IPV6=n

# Bootloader
CONFIG_BOOTLOADER_SKIP_VALIDATE_ALWAYS=y
```

## examples/development_kit/meshkit_sense/sdkconfig.defaults
```kconfig
# Override some defaults in mesh application project.

#
# Bootloader config
#
CONFIG_LOG_BOOTLOADER_LEVEL_WARN=y
CONFIG_LOG_BOOTLOADER_LEVEL_INFO=
CONFIG_LOG_BOOTLOADER_LEVEL=2

#
# Serial flasher config
#
CONFIG_ESPTOOLPY_FLASHSIZE_2MB=
CONFIG_ESPTOOLPY_FLASHSIZE_4MB=y

#
# Partition Table
#
CONFIG_PARTITION_TABLE_SINGLE_APP=
CONFIG_PARTITION_TABLE_CUSTOM=y
CONFIG_PARTITION_TABLE_CUSTOM_FILENAME="partitions.csv"

#
# Component config
#

#
# Bluetooth
#
CONFIG_BT_ENABLED=y
CONFIG_GATTC_ENABLE=
CONFIG_BLE_SMP_ENABLE=
CONFIG_BT_ACL_CONNECTIONS=2
CONFIG_BLE_SCAN_DUPLICATE=
CONFIG_BT_BLE_DYNAMIC_ENV_MEMORY=y
CONFIG_BTDM_CONTROLLER_MODEM_SLEEP=
CONFIG_BT_STACK_NO_LOG=

#
# ESP32-specific
#
CONFIG_MEMMAP_SMP=
CONFIG_ESP32_ENABLE_COREDUMP_TO_FLASH=y
CONFIG_ESP32_ENABLE_COREDUMP_TO_NONE=
CONFIG_ESP32_ENABLE_COREDUMP=y
CONFIG_ESP32_CORE_DUMP_LOG_LEVEL=1
CONFIG_SYSTEM_EVENT_TASK_STACK_SIZE=4096
CONFIG_MAIN_TASK_STACK_SIZE=8192
CONFIG_TIMER_TASK_STACK_SIZE=4096
CONFIG_TASK_WDT_TIMEOUT_S=10

#
# Wi-Fi
#
CONFIG_ESP32_WIFI_AMPDU_TX_ENABLED=
CONFIG_ESP32_WIFI_AMPDU_RX_ENABLED=

#
# FreeRTOS
#
CONFIG_FREERTOS_UNICORE=y
CONFIG_FREERTOS_HZ=1000
CONFIG_TIMER_TASK_STACK_DEPTH=3072
CONFIG_FREERTOS_USE_TRACE_FACILITY=y
CONFIG_FREERTOS_USE_STATS_FORMATTING_FUNCTIONS=y

#
# mbedTLS
#
CONFIG_MBEDTLS_HARDWARE_MPI=y

#
# MDF Mupgrade
#
CONFIG_MUPGRADE_FIRMWARE_CHECK=y
CONFIG_MUPGRADE_VERSION_FALLBACK_RESTART=

#
# Enable ULP
#
CONFIG_ULP_COPROC_ENABLED=y
CONFIG_ULP_COPROC_RESERVE_MEM=4096
```

## examples/development_kit/sense/main/Kconfig.projbuild
```kconfig
menu "Example Configuration"

    config SENSE_ENABLE_ULP_WAKEUP
        bool "Use ulp as a wakeup stub"
        default y
        help
            This option enables wake up from deep sleep using ULP.
            ULP program monitors the luminance sensor bh1750 and
            wakes up the chip when the luminance goes outside of
            low and upper threshold.

    config SENSE_ULP_READ_INTERVAL
        int "Time interval of ulp read data from sensor (millisecond)"
        default 1000
        range 1 65535
        depends on SENSE_ENABLE_ULP_WAKEUP

    config SENSE_ENABLE_EXT1_WAKEUP
        bool "Use extern interrupt 1 as a wakeup stub"
        default y
        help
            The GPIO EXT1 is GPIO_NUM_34, actually it's WakeUp button in board,
            and when the chip wakes up from EXT1, it will switch to mesh mode.

    config SENSE_ENABLE_TIMER_WAKEUP
        bool "Use timer as a wakeup stub"
        default n

    config SENSE_TIMER_WAKE_UP_INTERVAL
        int "Timer interval of deepsleep (millisecond)"
        default 60000
        range 10000 65535
        depends on SENSE_ENABLE_TIMER_WAKEUP

    config SENSE_LUMINANCE_THRESHOLD_LOW
        int "Low threshold of luminance to trigger (lux)"
        default 200
        range 0 65535

    config SENSE_LUMINANCE_THRESHOLD_UPPER
        int "Upper threshold of luminance to trigger (lux)"
        default 1000
        range 0 65535

    config SENSE_USE_EPAPER_DISPLAY
        bool "Use epaper to display sensor status"
        default n
        
endmenu
```

## examples/espnow_debug/main/Kconfig.projbuild
```kconfig
menu "MDF Debug terminal"

config AUTO_CONNECT_TO_DEFAULT_AP
    bool "Auto connnect to default AP when power on"
    default n
    help
        Connect to default AP when power on.
        If disabled, you can use command to connect to AP,
        or use command set channel to receive log without connect to AP.

config SAVE_TO_SDCARD
    bool "Save log&coredump to sdcard"
    default y
    help
        Save log and coredump data that espnow terminal device received to sdcard,
        if there is no sdcard, it should be disabled.

config SHOW_IN_LCD
    bool "Show informations in lcd"
    default y
    help
        Show mesh network informations and devices running status(include numbers
        of error&warning log and coredump) in lcd.

config DEFAULT_ROUTER_SSID
    string "WiFi SSID"
    default "router_ssid"
    depends on AUTO_CONNECT_TO_DEFAULT_AP
    help
        SSID (network name) for the espnow terminal device to connect to.

config DEFAULT_ROUTER_PASSWD
    string "WiFi Password"
    default "router_password"
    depends on AUTO_CONNECT_TO_DEFAULT_AP
    help
        WiFi password (WPA or WPA2) for the espnow terminal device to use.
        Can be left blank if the network has no security set.

config DEFAULT_UART_BAUDRATE
    int "Default UART baudrate for console"
    default 115200
    help
        ESPNOW receiver will print logs from different devices.
        Use high baudrate could reduce the chance of missing logs.

endmenu
```

## examples/espnow_debug/sdkconfig.defaults
```kconfig
# Override some defaults in mdf project.

#
# Bootloader config
#
CONFIG_LOG_BOOTLOADER_LEVEL_WARN=y
CONFIG_LOG_BOOTLOADER_LEVEL_INFO=
CONFIG_LOG_BOOTLOADER_LEVEL=2

#
# Serial flasher config
#
CONFIG_ESPTOOLPY_FLASHSIZE_2MB=
CONFIG_ESPTOOLPY_FLASHSIZE_4MB=y

#
# Partition Table
#
CONFIG_PARTITION_TABLE_SINGLE_APP=
CONFIG_PARTITION_TABLE_CUSTOM=y
CONFIG_PARTITION_TABLE_CUSTOM_FILENAME="partitions.csv"
CONFIG_PARTITION_TABLE_CUSTOM_APP_BIN_OFFSET=0xc0000
CONFIG_PARTITION_TABLE_FILENAME="partitions.csv"
CONFIG_APP_OFFSET=0xc0000

#
# Component config
#

#
# Bluetooth
#
CONFIG_BT_ENABLED=y

#
# ESP32-specific
#
CONFIG_MEMMAP_SMP=
CONFIG_ESP32_ENABLE_COREDUMP_TO_FLASH=y
CONFIG_ESP32_ENABLE_COREDUMP_TO_NONE=
CONFIG_ESP32_ENABLE_COREDUMP=y
CONFIG_ESP32_CORE_DUMP_LOG_LEVEL=1
CONFIG_SYSTEM_EVENT_TASK_STACK_SIZE=4096
CONFIG_MAIN_TASK_STACK_SIZE=8192
CONFIG_TIMER_TASK_STACK_SIZE=4096
CONFIG_TASK_WDT_TIMEOUT_S=10

#
# Wi-Fi
#
CONFIG_ESP32_WIFI_AMPDU_TX_ENABLED=
CONFIG_ESP32_WIFI_AMPDU_RX_ENABLED=

#
# FreeRTOS
#
CONFIG_FREERTOS_UNICORE=y
CONFIG_FREERTOS_HZ=1000
CONFIG_TIMER_TASK_STACK_DEPTH=3072
CONFIG_FREERTOS_USE_TRACE_FACILITY=y
CONFIG_FREERTOS_USE_STATS_FORMATTING_FUNCTIONS=y

#
# mbedTLS
#
CONFIG_MBEDTLS_HARDWARE_MPI=y
```
