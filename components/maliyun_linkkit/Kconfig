## components/maliyun_linkkit/Kconfig
```kconfig
menu "MDF support aliyun linkkit"

config MESH_SUPPORT_ALIYUN_LINKKIT
    bool "MDF support aliyun linkkit"
    default n
    help
        MDF support aliyun linkkit.

config MALIYUN_NETWORK_ID
    string "Maliyun network distinguishing ID"
    depends on MESH_SUPPORT_ALIYUN_LINKKIT
    default "xxxxxxxxxxxxxxx"
    help
        Used to help products that are not available to the manufacturer to form a network under the same router.

config MALIYUN_NETWORK_KEY
    string "Maliyun network communication key"
    depends on MESH_SUPPORT_ALIYUN_LINKKIT
    default "xxxxxxxxxxxxxxx"
    help
        Mesh network encryption key, which needs to be paired with MALIYUN_NETWORK_ID. Note: If MALIYUN_NETWORK_ID is the same, MALIYUN_NETWORK_KEY is different, there will be a network failure between devices.
endmenu
```

## components/mcommon/Kconfig
```kconfig
menu "MDF Mcommon"

config MDF_TASK_DEFAULT_PRIOTY
    int "Task's priority "
    default 6
    help
        Configure the priority of all mesh tasks

choice MDF_TASK_PINNED_TO_CORE_CHOICE
    prompt "The cpu core which MDF run"
    depends on !FREERTOS_UNICORE
    help
        Which the cpu core to run MDF. Can choose core0 and core1.
        Can not specify no-affinity.

config MDF_PINNED_TO_CORE_0
    bool "Core 0 (PRO CPU)"
config MDF_PINNED_TO_CORE_1
    bool "Core 1 (APP CPU)"
    depends on !FREERTOS_UNICORE
endchoice

config MDF_TASK_PINNED_TO_CORE
    int
    default 0 if MDF_PINNED_TO_CORE_0
    default 1 if MDF_PINNED_TO_CORE_1
    default 0

config MDF_MEM_DEBUG
    bool "Memory debug"
    default y
    help
        Memory debug.

config MDF_ERR_TO_NAME_LOOKUP
    bool "Enable lookup of error code strings"
    default y
    help
        Functions mdf_err_to_name() return string representations of error codes
        from a pre-generated lookup table. This option can be used to turn off
        the use of the look-up table in order to save memory but this comes at
        the price of sacrificing  distinguishable (meaningful) output string
        representations.

choice MDF_LOG_LEVEL
    bool "Configure the mesh application layer's log"
    default MDF_LOG_LEVEL_DEBUG
    help
         Specify how much output to see in logs by default.
         Note that this setting limits which log statements
         are compiled into the program. So setting this to, say,
         "Warning" would mean that changing log level to "Debug"
         at runtime will not be possible.

config MDF_LOG_LEVEL_NONE
   bool "No output"
config MDF_LOG_LEVEL_ERROR
   bool "Error"
config MDF_LOG_LEVEL_WARN
   bool "Warning"
config MDF_LOG_LEVEL_INFO
   bool "Info"
config MDF_LOG_LEVEL_DEBUG
   bool "Debug"
config MDF_LOG_LEVEL_VERBOSE
   bool "Verbose"
endchoice

config MDF_LOG_LEVEL
    int
    default 0 if MDF_LOG_LEVEL_NONE
    default 1 if MDF_LOG_LEVEL_ERROR
    default 2 if MDF_LOG_LEVEL_WARN
    default 3 if MDF_LOG_LEVEL_INFO
    default 4 if MDF_LOG_LEVEL_DEBUG
    default 5 if MDF_LOG_LEVEL_VERBOSE


endmenu
```

## components/mconfig/Kconfig
```kconfig
menu "MDF Mconfig"

    config MCONFIG_WHITELIST_ENABLE
        bool "Enables mconfig whitelist"
        default y
        help
            When configuring the network, the devices on the non-white list will be filtered.

    config MCONFIG_WHITELIST_SECURITY_ENABLE
        bool "Prevent counterfeit device attacks"
        default n
        depends on MCONFIG_WHITELIST_ENABLE
        help
            Perform RSA key pair verification to prevent pseudo device attacks.

    config MCONFIG_WHITELIST_CHECKSUM_SIZE
        int "RSA's public key check code length"
        default 32
        depends on MCONFIG_WHITELIST_SECURITY_ENABLE
        help
            RSA's public key check code length.

    config MCONFIG_PARTITION_SUBTYPE
        int "RSA partition type"
        default 154
        depends on MCONFIG_WHITELIST_SECURITY_ENABLE
        help
            Partition type, one of esp_partition_type_t values.

    config MCONFIG_PARTITION_LABLE
        string "RSA partition label"
        default "mconfig_rsa"
        depends on MCONFIG_WHITELIST_SECURITY_ENABLE
        help
            Set this value if looking for partition with a specific name.

    config MCONFIG_CHAIN_LMK
        string "Espnow communication encrypted key"
        default "lmk1234567890123"
        help
            Espnow communication encrypted key in mconfig distribution network.

    config MCONFIG_CUSTOM_EXTERN_LEN
        int "Extend the length of custom data"
        range 0 223
        default 0
        help
            Different length versions are incompatible. Increasing the length
            will affect the network configuration time.
    
    config MCONFIG_DIRECT_CONNECT_ROUTER
        bool "Connect to router directly"
        default n
        help
            If it set, the device will try to connect to router when provisioning, 
            otherwise the device will try to connect to mesh network with specific mesh_id

    config MCONFIG_VERIFY_ROUTER
        bool "Verify router password"
        default y
        help
            If it is set, the mesh_password will generate by ap_password and mesh_password which
            are passed from app.
            
endmenu
```

## components/mdebug/Kconfig
```kconfig
menu "MDF Mdebug"

    config MDEBUG_STORE_HISTORY
        bool "Store command history in flash"
        default n
        help
            Linenoise line editing library provides functions to save and load
            command history. If this option is enabled, initalizes a FAT filesystem
            and uses it to store command history.

    config MDEBUG_PARTITION_LABEL
        string "Store command history partition label"
        default "storage"
        depends on MDEBUG_STORE_HISTORY
        help
            Store command history partition label.

    config MDEBUG_LOG_PARTITION_LABEL
        string "Store log info partition label"
        default "reserved"
        help
            Store log info partition label.

    config MDEBUG_LOG_PARTITION_OFFSET
        int "Offset of the log information partition"
        range 0 524288
        default 0
        help
            Offset of the log information partition

    config MDEBUG_LOG_PACKET_MAX_SIZE
        int "Maximum length of a single packet of data when wirelessly transmitting logs"
        range 236 2378
        default 1188
        help
            Maximum length of a single packet of data when wirelessly transmitting logs

    config MDEBUG_LOG_FILE_MAX_SIZE
        int "Output the save the file size of the log"
        range 8196 131072
        default 32768
        help
            Output the Save the file size of the log

    config MDEBUG_PRINTF_ENABLE
        bool "Output the `printf` information of the mdebug module"
        default n
        help
            Output the `printf` information of the mdebug module

endmenu
```

## components/mespnow/Kconfig
```kconfig
menu "MDF Mespnow"

    config MESPNOW_RETRANSMIT_NUM
        int "Number of data retransmissions"
        default 3
        help
            Number of data retransmissions

    config MESPNOW_DEFAULT_PMK
        string "primary master key is used to encrypt local master key"
        default "pmk1234567890123"
        help
            primary master key is used to encrypt local master key

    config MESPNOW_LOG_LEVEL
        int "Mespnow logging level"
        default 2
        help
            Config mespnow logging level (0-5).

menu "Mespnow queue size"
    config MESPNOW_TRANS_PIPE_DEBUG_QUEUE_SIZE
        int "Mespnow debug pipe queue size"
        default 5
    config MESPNOW_TRANS_PIPE_CONTROL_QUEUE_SIZE
        int "Mespnow control pipe queue size"
        default 5
    config MESPNOW_TRANS_PIPE_MCONFIG_QUEUE_SIZE
        int "Mespnow mconfig pipe queue size"
        default 10
    config MESPNOW_TRANS_PIPE_RESERVED_QUEUE_SIZE
        int "Mespnow reserved pipe queue size"
        default 5
endmenu

endmenu
```

## components/mupgrade/Kconfig
```kconfig
menu "MDF Mupgrade"

    config MUPGRADE_RETRY_COUNT
        int "Number of times the firmware failed to retry"
        default 20
        help
            Number of times the firmware failed to retry

    config MUPGRADE_FLOW_CONTROL_LEVEL
        int "flow control level for root send firmware"
        default 5
        range 0 10
        help
            level of flow control in mesh ota, 10 is the max

    config MUPGRADE_WAIT_RESPONSE_TIMEOUT
        int "Timeout waiting for a response (ms)"
        default 3000
        help
            Timeout period for requesting an upgrade status waiting for a response

    config MUPGRADE_STATUS_REPORT_INTERVAL
        int "The interval at which the upgrade progress is actively reported"
        range 1 100
        default 10
        help
            The interval at which the upgrade progress is actively reported

    config MUPGRADE_FIRMWARE_CHECK
        bool "Check if the Mupgrade module is included"
        default n
        help
        Check if the Mupgrade module is included.

    config MUPGRADE_FIRMWARE_FLAG
        string "Check if this identifier is included in the firmware"
        default "** MUPGRADE_FIRMWARE_FLAG **"
        depends on MUPGRADE_FIRMWARE_CHECK
        help
        Check if this identifier is included in the firmware.

    config MUPGRADE_VERSION_FALLBACK_RESTART
        bool "Fall back to the previous version"
        default y
        help
        If there is a factory partition, it will switch to the factory partition.

    config MUPGRADE_RESTART_COUNT
        int "How many times to restart continuously"
        default 15
        depends on MUPGRADE_VERSION_FALLBACK_RESTART
        help
        How many times to restart continuously.

    config MUPGRADE_RESTART_TIMEOUT
        int "Continuous restart interval(ms)"
        default 5000
        depends on MUPGRADE_VERSION_FALLBACK_RESTART
        help
        Continuous restart interval.

    config MUPGRADE_VERSION_FALLBACK_FACTORY
        bool "If there is a factory partition, fall back to the factory version"
        default y
        depends on MUPGRADE_VERSION_FALLBACK_RESTART
        help
        If there is a factory partition, fall back to the factory version instead
        of rolling back to the previous version

endmenu
```
